## firmware/homagotchi-companion/sdkconfig.defaults
```kconfig
# Bluetooth controller
CONFIG_BT_ENABLED=y
CONFIG_BT_CONTROLLER_ENABLED=y
CONFIG_BT_CONTROLLER_ONLY=n
CONFIG_BT_BLUEDROID_ENABLED=y
CONFIG_BT_BLE_ENABLED=y
CONFIG_BT_CLASSIC_ENABLED=n
CONFIG_BT_BLE_42_FEATURES_SUPPORTED=y

# WiFi
CONFIG_ESP_WIFI_ENABLED=y

# Console over USB (Atom S3 native USB)
CONFIG_ESP_CONSOLE_USB_SERIAL_JTAG=y
```
